## conf/bblayers.conf
```bitbake
# POKY_BBLAYERS_CONF_VERSION is increased each time build/conf/bblayers.conf
# changes incompatibly
POKY_BBLAYERS_CONF_VERSION = "2"

BBPATH = "${TOPDIR}"
BBFILES ?= ""

BBLAYERS ?= " \
  /opt/icarium/yocto/poky/meta \
  /opt/icarium/yocto/poky/meta-poky \
  /opt/icarium/yocto/poky/meta-yocto-bsp \
  /opt/icarium/yocto/meta-openembedded/meta-oe \
  /opt/icarium/yocto/meta-qt5 \
  /opt/icarium/yocto/meta-raspberrypi \
  /opt/icarium/yocto/meta-qtbrew \ 
  "
```
